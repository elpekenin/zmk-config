/*
 * Copyright (c) 2024 The ZMK Contributors
 *
 * SPDX-License-Identifier: MIT
 */

#include "elpekenin/behaviors.dtsi"

/* logic inverted to make stay ON during use, OFF while sleeping */
&blue {
    gpios = <&gpio1 2 GPIO_ACTIVE_HIGH>;
};

/* make soft-off toggle GPIO used for LED sleep state */
// &soft_off_callback {
//     bindings = <&gpio 1 GPIO_TOG>, <&soft_off>;
// };
