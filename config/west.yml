## config/west.yml
```yaml
manifest:
  remotes:
    - name: zmkfirmware
      url-base: https://github.com/zmkfirmware
    - name: ebastler
      url-base: https://github.com/ebastler
    - name: petejohanson
      url-base: https://github.com/petejohanson
    - name: elpekenin
      url-base: https://github.com/elpekenin
  projects:
    - name: zmk
      remote: zmkfirmware
      revision: main
      import: app/west.yml
    - name: zmk-userspace
      remote: elpekenin
      revision: main
    - name: cornholius
      remote: elpekenin
      revision: main
  self:
    path: config
```
