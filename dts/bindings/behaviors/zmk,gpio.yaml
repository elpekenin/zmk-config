## dts/bindings/behaviors/zmk,gpio.yaml
```yaml
# Copyright (c) 2024 The ZMK Contributors
# SPDX-License-Identifier: MIT

description: GPIO Behavior

compatible: "zmk,behavior-gpio"

include: two_param.yaml
```

## dts/bindings/elpekenin,layer-callback.yaml
```yaml
# Copyright (c) 2024 The ZMK Contributors
# SPDX-License-Identifier: MIT

description: Tap (press and release) behavior(s) when a layer is (de)activated

compatible: "elpekenin,layer-callback"

child-binding:
  description: "A layer's config"

  properties:
    layer:
      type: int
      required: true

  child-binding:
    properties:
      bindings:
        type: phandle-array
        description: "On/off bindings"
```
